## apps/my_application/build/Kconfig/Kconfig.shield
```kconfig
osource "D:/Desktop/source/dht22/apps/my_application/../..//boards/shields/*/Kconfig.shield"
```

## drivers/Kconfig
```kconfig
menu "My drivers"

rsource "sample_gpio_driver/Kconfig"
rsource "greetings_driver/Kconfig"
rsource "dht_driver/Kconfig"

endmenu
```

## drivers/dht_driver/Kconfig
```kconfig
config DHT
	bool "DHT Temperature and Humidity Sensor"
	default y
	depends on DT_HAS_AOSONG_DHT_ENABLED
	depends on GPIO
	help
	  Enable driver for the DHT temperature and humidity sensor family.
```

## drivers/dts/bindings/funny_driver_name/ao-song,dht.yaml
```yaml
description: |
    An example sensor that reads the GPIO level defined in input-gpios.

compatible: "aosong,dht"

properties:
    dio-gpios:
        type: phandle-array
        required: true
        description: |
            Input gpios.

include: base.yaml
```

## drivers/dts/bindings/funny_driver_name/zephyr,funny-driver-name.yaml
```yaml
description: |
    An example sensor that reads the GPIO level defined in input-gpios.

compatible: "zephyr,funny-driver-name"

properties:
    input-gpios:
        type: phandle-array
        required: true
        description: |
            Input gpios.

include: base.yaml
```

## drivers/greetings_driver/Kconfig
```kconfig
config GREETINGS_DRIVER
    bool "Formal greetings driver"
    help
        Formal greetings driver

config GREETINGS_PROMPT
    string "Change how the driver greets the users"
    default "Hello from the kernel"
    help
        Provide configuration option to change the greeting prompts of the driver
```

## drivers/sample_gpio_driver/Kconfig
```kconfig
menuconfig THIS_IS_MY_DRIVER
    bool "My sample basic gpio sensor driver"
    help
        My sample basic gpio sensor driver

config SAMPLE_GPIO_DRIVER
    bool "My sample basic gpio sensor driver"
    help
        My sample basic gpio sensor driver


config CONFIG_NEW_GPIO_DRIVER_V2
    bool "Use sample_gpio"
    help
        Select this to use the serious driver
config FUNNY_DRIVER_NAME
    bool "Use my funny driver"
    default y
    depends on DT_HAS_ZEPHYR_FUNNY_DRIVER_NAME_ENABLED
    help
        Select this to use the funny driver
```
